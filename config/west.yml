## config/west.yml
```yaml
manifest:
  remotes:
    - name: zmkfirmware
      url-base: https://github.com/zmkfirmware
    - name: davidphilipbarr
      url-base: https://github.com/davidphilipbarr
    - name: Silcantar
      url-base: https://github.com/Silcantar
    - name: invrtd
      url-base: https://github.com/invrtd
  projects:
    - name: zmk
      remote: invrtd # zmkfirmware #
      revision: nice!view-180 # v0.3 #
      import: app/west.yml
    - name: nicehatharry
      remote: davidphilipbarr
      clone-depth: 1
      revision: main
    - name: zmk-mantis
      remote: Silcantar
      clone-depth: 1
      revision: main
  self:
    path: config
```
