/ {
    combos {
        compatible = "zmk,combos";
        combo_caps_word {
            timeout-ms = <500>;
            key-positions = <33 38>;
            bindings = <&caps_word>;
        };
    };
};
